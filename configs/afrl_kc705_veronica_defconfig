## configs/afrl_kc705_veronica_defconfig
```kconfig
# ARCH
BR2_riscv=y
BR2_RISCV_32=y

# ISE
BR2_riscv_custom=y
BR2_RISCV_ISA_RVM=y
BR2_RISCV_ISA_RVA=y
BR2_RISCV_ISA_RVC=y
BR2_RISCV_ABI_ILP32=y

# OPENSBI (disabled)
##BR2_TARGET_OPENSBI=y
##BR2_TARGET_OPENSBI_CUSTOM_VERSION=y
##BR2_TARGET_OPENSBI_CUSTOM_VERSION_VALUE="1.7"
##BR2_TARGET_OPENSBI_PLAT="generic"
##BR2_TARGET_OPENSBI_ADDITIONAL_VARIABLES="FW_OPTIONS=0 FW_TEXT_START=0x80000000"
##BR2_TARGET_OPENSBI_UBOOT_PAYLOAD=y
##BR2_TARGET_OPENSBI_FW_FDT_PATH=y

# KERNEL
BR2_PACKAGE_HOST_LINUX_HEADERS_CUSTOM_6_6=y
BR2_LINUX_KERNEL=y
BR2_LINUX_KERNEL_IMAGEGZ=y
BR2_LINUX_KERNEL_CUSTOM_TARBALL=y
BR2_LINUX_KERNEL_CUSTOM_TARBALL_LOCATION="$(call github,johnathan-convertino-afrl,linux,57231cc95352ce4349641bd40959ebd77ea2a93f)/afrl_ad_master.tar.gz"
BR2_LINUX_KERNEL_DEFCONFIG="veronica"
BR2_LINUX_KERNEL_DTS_SUPPORT=y
BR2_LINUX_KERNEL_INTREE_DTS_NAME="veronica/afrl_kc705_veronica"
BR2_LINUX_KERNEL_NEEDS_HOST_OPENSSL=y

# UBOOT (disabled)
##BR2_TARGET_UBOOT=y
##BR2_TARGET_UBOOT_BUILD_SYSTEM_KCONFIG=y
##BR2_TARGET_UBOOT_CUSTOM_TARBALL=y
##BR2_TARGET_UBOOT_CUSTOM_TARBALL_LOCATION="$(call github,johnathan-convertino-afrl,u-boot-veronica,a657130b20a8bfeaaf9954e1426b54aa2fc7a127)/afrl_uboot_master.tar.gz"
##BR2_TARGET_UBOOT_BOARD_DEFCONFIG="afrl_veronica"
##BR2_TARGET_UBOOT_NEEDS_DTC=y
##BR2_TARGET_UBOOT_NEEDS_OPENSSL=n
##BR2_TARGET_UBOOT_NEEDS_GNUTLS=n
##BR2_TARGET_UBOOT_FORMAT_IMG=y

# ROOTFS
BR2_ROOTFS_POST_SCRIPT_ARGS="ttyUL0,115200"
BR2_TARGET_GENERIC_HOSTNAME="lancelot"
BR2_TARGET_GENERIC_ISSUE="Welcome to AFRL Veronica RISCV Linux"
BR2_TARGET_ROOTFS_CPIO=y
BR2_TARGET_ROOTFS_CPIO_GZIP=y
BR2_TARGET_ROOTFS_CPIO_UIMAGE=y
BR2_TARGET_ROOTFS_EXT2=y
BR2_TARGET_ROOTFS_EXT2_4=y
BR2_PACKAGE_INPUT_EVENT_DAEMON=y
BR2_PACKAGE_ZLIB=y
BR2_PACKAGE_POLL_SYSFS=y
BR2_ROOTFS_OVERLAY="board/veronica_base/afrl/all/rootfs_overlay_no_eth0"
BR2_ROOTFS_USERS_TABLES="board/veronica_base/afrl/all/users.txt"
BR2_TARGET_ROOTFS_EXT2_SIZE="512M"
BR2_TARGET_ENABLE_ROOT_LOGIN=y
BR2_TARGET_GENERIC_ROOT_PASSWD="afrl"
BR2_ROOTFS_POST_BUILD_SCRIPT="board/veronica_base/afrl/all/post-build.sh"
BR2_PACKAGE_FRU_TOOLS=y
BR2_PACKAGE_NANO=y
#BR2_PACKAGE_OPENSSH=y
```

## configs/nexys_a7_veronica_defconfig
```kconfig
# Target options
BR2_riscv=y
BR2_RISCV_32=y

# Instruction Set Extensions
BR2_riscv_custom=y
BR2_RISCV_ISA_RVM=y
BR2_RISCV_ISA_RVA=y
BR2_RISCV_ISA_RVC=y
BR2_RISCV_ABI_ILP32=y

# OPENSBI
BR2_TARGET_OPENSBI=y
BR2_TARGET_OPENSBI_CUSTOM_VERSION=y
BR2_TARGET_OPENSBI_CUSTOM_VERSION_VALUE="1.7"
BR2_TARGET_OPENSBI_PLAT="generic"

# KERNEL
BR2_LINUX_KERNEL=y
BR2_LINUX_KERNEL_IMAGEGZ=y
BR2_LINUX_KERNEL_CUSTOM_TARBALL=y
BR2_LINUX_KERNEL_CUSTOM_TARBALL_LOCATION="$(call github,johnathan-convertino-afrl,linux,57231cc95352ce4349641bd40959ebd77ea2a93f)/afrl_ad_master.tar.gz"
BR2_LINUX_KERNEL_DEFCONFIG="veronica"
BR2_LINUX_KERNEL_DTS_SUPPORT=y
BR2_LINUX_KERNEL_INTREE_DTS_NAME="veronica/afrl_veronica"
BR2_LINUX_KERNEL_NEEDS_HOST_OPENSSL=y

# User
BR2_PACKAGE_HOST_LINUX_HEADERS_CUSTOM_6_6=y
BR2_ROOTFS_POST_SCRIPT_ARGS="ttyUL0,115200 mmcblk0p2"
BR2_TARGET_GENERIC_HOSTNAME="jeter"
BR2_TARGET_GENERIC_ISSUE="Welcome to AFRL Veronica RISCV Linux"
BR2_TARGET_ROOTFS_EXT2=y
BR2_TARGET_ROOTFS_EXT2_4=y
BR2_TARGET_UBOOT=n
BR2_PACKAGE_INPUT_EVENT_DAEMON=y
BR2_PACKAGE_ZLIB=y
BR2_PACKAGE_POLL_SYSFS=y
BR2_ROOTFS_OVERLAY="board/rfbase/afrl/all/rootfs_overlay"
BR2_ROOTFS_USERS_TABLES="board/rfbase/afrl/all/users.txt"
BR2_TARGET_ROOTFS_EXT2_SIZE="512M"
BR2_TARGET_ENABLE_ROOT_LOGIN=y
BR2_TARGET_GENERIC_ROOT_PASSWD="afrl"
BR2_ROOTFS_POST_BUILD_SCRIPT="board/rfbase/afrl/all/post-build.sh"
BR2_PACKAGE_FRU_TOOLS=y
BR2_PACKAGE_NANO=y
BR2_PACKAGE_OPENSSH=y
```

## configs/zynq_zc706_ad_fmcomms5_defconfig
```kconfig
BR2_arm=y
BR2_cortex_a9=y
BR2_ARM_ENABLE_NEON=y
BR2_ARM_ENABLE_VFP=y
BR2_PACKAGE_HOST_LINUX_HEADERS_CUSTOM_6_1=y
BR2_TARGET_GENERIC_HOSTNAME="rose"
BR2_TARGET_GENERIC_ISSUE="Welcome to AFRL AD RF Comms"
BR2_LINUX_KERNEL=y
BR2_LINUX_KERNEL_CUSTOM_TARBALL=y
BR2_LINUX_KERNEL_CUSTOM_TARBALL_LOCATION="$(call github,johnathan-convertino-afrl,linux,feb9b3b07319dfc00f69608237cc06ef5ce1365a)/afrl_ad_master.tar.gz"
BR2_LINUX_KERNEL_DEFCONFIG="zynq_xcomm_adv7511"
BR2_LINUX_KERNEL_UIMAGE=y
BR2_LINUX_KERNEL_UIMAGE_LOADADDR="0x8000"
BR2_LINUX_KERNEL_DTS_SUPPORT=y
BR2_LINUX_KERNEL_INTREE_DTS_NAME="zynq-zc706-ad9361-fmcomms5"
BR2_LINUX_KERNEL_NEEDS_HOST_OPENSSL=y
BR2_TARGET_ROOTFS_EXT2=y
BR2_TARGET_ROOTFS_EXT2_4=y
BR2_TARGET_UBOOT=n
BR2_PACKAGE_INPUT_EVENT_DAEMON=y
BR2_PACKAGE_ZLIB=y
BR2_PACKAGE_LIBAD9361_IIO=y
BR2_PACKAGE_LIBIIO_IIOD_USBD=y
BR2_PACKAGE_LIBIIO_TESTS=y
BR2_PACKAGE_LIBINI=y
BR2_PACKAGE_AVAHI=y
BR2_PACKAGE_AVAHI_DAEMON=y
BR2_PACKAGE_AVAHI_LIBDNSSD_COMPATIBILITY=y
BR2_PACKAGE_IW=y
BR2_PACKAGE_WPA_SUPPLICANT=y
BR2_PACKAGE_WPA_SUPPLICANT_CLI=y
BR2_PACKAGE_WPA_SUPPLICANT_PASSPHRASE=y
BR2_PACKAGE_POLL_SYSFS=y
BR2_PACKAGE_AD936X_REF_CAL=y
BR2_ROOTFS_OVERLAY="board/rfbase/afrl/all/rootfs_overlay"
BR2_ROOTFS_USERS_TABLES="board/rfbase/afrl/all/users.txt"
BR2_TARGET_ROOTFS_EXT2_SIZE="512M"
BR2_TARGET_ENABLE_ROOT_LOGIN=y
BR2_TARGET_GENERIC_ROOT_PASSWD="afrl"
BR2_ROOTFS_POST_BUILD_SCRIPT="board/rfbase/afrl/all/post-build.sh"
```

## configs/zynq_zed_ad_fmcomms2-3_defconfig
```kconfig
BR2_arm=y
BR2_cortex_a9=y
BR2_ARM_ENABLE_NEON=y
BR2_ARM_ENABLE_VFP=y
BR2_PACKAGE_HOST_LINUX_HEADERS_CUSTOM_6_1=y
BR2_LINUX_KERNEL=y
BR2_LINUX_KERNEL_CUSTOM_TARBALL=y
BR2_LINUX_KERNEL_CUSTOM_TARBALL_LOCATION="$(call github,johnathan-convertino-afrl,linux,291cb87)/afrl_ad_master.tar.gz"
BR2_LINUX_KERNEL_DEFCONFIG="zynq_xcomm_adv7511"
BR2_LINUX_KERNEL_UIMAGE=y
BR2_LINUX_KERNEL_UIMAGE_LOADADDR="0x8000"
BR2_LINUX_KERNEL_DTS_SUPPORT=y
BR2_LINUX_KERNEL_INTREE_DTS_NAME="zynq-zed-ad9361-fmcomms2-3"
BR2_LINUX_KERNEL_NEEDS_HOST_OPENSSL=y
BR2_TARGET_ROOTFS_EXT2=y
BR2_TARGET_ROOTFS_EXT2_4=y
BR2_TARGET_UBOOT=n
BR2_PACKAGE_INPUT_EVENT_DAEMON=y
BR2_PACKAGE_ZLIB=y
BR2_PACKAGE_LIBAD9361_IIO=y
BR2_PACKAGE_LIBIIO_IIOD_USBD=y
BR2_PACKAGE_LIBIIO_TESTS=y
BR2_PACKAGE_LIBINI=y
BR2_PACKAGE_AVAHI=y
BR2_PACKAGE_AVAHI_DAEMON=y
BR2_PACKAGE_AVAHI_LIBDNSSD_COMPATIBILITY=y
BR2_PACKAGE_IW=y
BR2_PACKAGE_WPA_SUPPLICANT=y
BR2_PACKAGE_WPA_SUPPLICANT_CLI=y
BR2_PACKAGE_WPA_SUPPLICANT_PASSPHRASE=y
BR2_PACKAGE_POLL_SYSFS=y
BR2_PACKAGE_AD936X_REF_CAL=y
```

## configs/zynqmp_zcu102_ad_fmcomms2-3_defconfig
```kconfig
BR2_aarch64=y
BR2_PACKAGE_HOST_LINUX_HEADERS_CUSTOM_5_15=y
BR2_ROOTFS_POST_SCRIPT_ARGS="ttyPS0,115200 mmcblk0p2"
BR2_LINUX_KERNEL=y
BR2_LINUX_KERNEL_CUSTOM_TARBALL=y
BR2_LINUX_KERNEL_CUSTOM_TARBALL_LOCATION="$(call github,analogdevicesinc,linux,2022_R2)/ad_2022_R2.tar.gz"
BR2_LINUX_KERNEL_DEFCONFIG="adi_zynqmp_defconfig"
BR2_LINUX_KERNEL_DTS_SUPPORT=y
BR2_LINUX_KERNEL_INTREE_DTS_NAME="xilinx/zynqmp-zcu102-rev10-ad9361-fmcomms2-3"
BR2_LINUX_KERNEL_NEEDS_HOST_OPENSSL=y
BR2_TARGET_ROOTFS_EXT2=n
BR2_TARGET_ROOTFS_EXT2_4=n
BR2_TARGET_UBOOT=n
BR2_GLOBAL_PATCH_DIR="board/zynqmp/patches"
```

## configs/zynqmp_zcu102_ad_fmcomms5_defconfig
```kconfig
BR2_aarch64=y
BR2_PACKAGE_HOST_LINUX_HEADERS_CUSTOM_6_1=y
BR2_ROOTFS_POST_SCRIPT_ARGS="ttyPS0,115200 mmcblk0p2"
BR2_TARGET_GENERIC_HOSTNAME="ernie"
BR2_TARGET_GENERIC_ISSUE="Welcome to AFRL AD RF Comms"
BR2_LINUX_KERNEL=y
BR2_LINUX_KERNEL_CUSTOM_TARBALL=y
BR2_LINUX_KERNEL_CUSTOM_TARBALL_LOCATION="$(call github,johnathan-convertino-afrl,linux,ade3b46)/afrl_ad_master_ade3b46.tar.gz"
BR2_LINUX_KERNEL_DEFCONFIG="adi_zynqmp"
BR2_LINUX_KERNEL_DTS_SUPPORT=y
BR2_LINUX_KERNEL_INTREE_DTS_NAME="xilinx/zynqmp-zcu102-rev10-ad9361-fmcomms5"
BR2_LINUX_KERNEL_NEEDS_HOST_OPENSSL=y
BR2_TARGET_ROOTFS_EXT2=y
BR2_TARGET_ROOTFS_EXT2_4=y
BR2_TARGET_UBOOT=n
BR2_GLOBAL_PATCH_DIR="board/zynqmp/patches"
BR2_PACKAGE_INPUT_EVENT_DAEMON=y
BR2_PACKAGE_ZLIB=y
BR2_PACKAGE_LIBAD9361_IIO=y
BR2_PACKAGE_LIBIIO_IIOD_USBD=y
BR2_PACKAGE_LIBIIO_TESTS=y
BR2_PACKAGE_LIBINI=y
BR2_PACKAGE_AVAHI=y
BR2_PACKAGE_AVAHI_DAEMON=y
BR2_PACKAGE_AVAHI_LIBDNSSD_COMPATIBILITY=y
BR2_PACKAGE_IW=y
BR2_PACKAGE_WPA_SUPPLICANT=y
BR2_PACKAGE_WPA_SUPPLICANT_CLI=y
BR2_PACKAGE_WPA_SUPPLICANT_PASSPHRASE=y
BR2_PACKAGE_POLL_SYSFS=y
BR2_PACKAGE_AD936X_REF_CAL=y
BR2_ROOTFS_OVERLAY="board/rfbase/afrl/all/rootfs_overlay"
BR2_ROOTFS_USERS_TABLES="board/rfbase/afrl/all/users.txt"
BR2_TARGET_ROOTFS_EXT2_SIZE="512M"
BR2_TARGET_ENABLE_ROOT_LOGIN=y
BR2_TARGET_GENERIC_ROOT_PASSWD="afrl"
```
